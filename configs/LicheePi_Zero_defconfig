## configs/LicheePi_Zero_defconfig
```kconfig
CONFIG_ARM=y
CONFIG_ARCH_SUNXI=y
CONFIG_DEFAULT_DEVICE_TREE="allwinner/sun8i-v3s-licheepi-zero"
CONFIG_SPL=y
CONFIG_MACH_SUN8I_V3S=y
# CONFIG_HAS_ARMV7_SECURE_BASE is not set
# CONFIG_CMD_IMLS is not set
# CONFIG_CMD_FLASH is not set
# CONFIG_CMD_FPGA is not set
CONFIG_SUN8I_EMAC=y
CONFIG_OF_LIBFDT_OVERLAY=y
CONFIG_PHY_SUN4I_USB=y
CONFIG_USB_GADGET=y
CONFIG_DM_USB_GADGET=y
CONFIG_USB_MUSB_GADGET=y
# CONFIG_USB_ETHER is not set
CONFIG_USB_FUNCTION_FASTBOOT=y
CONFIG_CMD_FASTBOOT=y
CONFIG_FASTBOOT_FLASH_MMC=y
# CONFIG_TOOLS_MKEFICAPSULE is not set
# CONFIG_ANDROID_BOOT_IMAGE is not set
CONFIG_FASTBOOT_BUF_ADDR=0x40000000
CONFIG_SYS_LOAD_ADDR=0x41000000
CONFIG_USE_PREBOOT=y
CONFIG_PREBOOT="mmc dev 0; mmc read 0x41000000 0x7FE 1; if itest.l *0x41000000 -eq 0xFA57B007; then mw.l 0x41000000 0 1; mmc write 0x41000000 0x7FE 1; setenv fastboot_raw_partition_uboot 0x10 0x2000; fastboot usb 0; fi"
CONFIG_USE_BOOTCOMMAND=y
CONFIG_BOOTCOMMAND="echo 'Booting from SD card (GPT)...'; mmc dev 0; if part start mmc 0 kernel kernel_start && part start mmc 0 dtb dtb_start; then mmc read 0x41000000 ${kernel_start} 0x5000; mmc read 0x41800000 ${dtb_start} 0x200; setenv bootargs console=ttyS0,115200 root=/dev/mmcblk0p4 rw rootwait gpt; bootz 0x41000000 - 0x41800000; fi; echo 'BOOT FAILED - entering fastboot...'; setenv fastboot_raw_partition_uboot 0x10 0x2000; fastboot usb 0"
CONFIG_SYS_MALLOC_LEN=0xA00000
CONFIG_STACK_SIZE=0x400000
```

## configs/LicheePi_Zero_recovery_defconfig
```kconfig
CONFIG_ARM=y
CONFIG_ARCH_SUNXI=y
CONFIG_DEFAULT_DEVICE_TREE="allwinner/sun8i-v3s-licheepi-zero"
CONFIG_SPL=y
CONFIG_MACH_SUN8I_V3S=y
# CONFIG_HAS_ARMV7_SECURE_BASE is not set
# CONFIG_CMD_IMLS is not set
# CONFIG_CMD_FLASH is not set
CONFIG_SPI=y
CONFIG_MTD=y
CONFIG_CMD_SF=y
CONFIG_CMD_SPI=y
# CONFIG_CMD_FPGA is not set
CONFIG_DM_SPI_FLASH=y
CONFIG_SPI_FLASH=y
CONFIG_SPI_FLASH_WINBOND=y
CONFIG_SPL_SPI_SUNXI=y
CONFIG_DM_SPI=y
CONFIG_SUNXI_SPI=y
CONFIG_SUN8I_EMAC=y
CONFIG_OF_LIBFDT_OVERLAY=y
CONFIG_PHY_SUN4I_USB=y
CONFIG_USB_GADGET=y
CONFIG_DM_USB_GADGET=y
CONFIG_USB_MUSB_GADGET=y
# CONFIG_USB_ETHER is not set
CONFIG_USB_FUNCTION_FASTBOOT=y
CONFIG_CMD_FASTBOOT=y
CONFIG_FASTBOOT_FLASH_MMC=y
# CONFIG_TOOLS_MKEFICAPSULE is not set
# CONFIG_ANDROID_BOOT_IMAGE is not set
CONFIG_USE_PREBOOT=y
CONFIG_PREBOOT="setenv fastboot_raw_partition_uboot 0x10 0x2000; setenv fastboot_timeout 5; fastboot usb 0"
CONFIG_USE_BOOTCOMMAND=y
CONFIG_BOOTCOMMAND="echo 'Booting from SD card (GPT)...'; mmc dev 0; if part start mmc 0 kernel kernel_start && part start mmc 0 dtb dtb_start; then mmc read 0x41000000 ${kernel_start} 0x5000; mmc read 0x41800000 ${dtb_start} 0x200; setenv bootargs console=ttyS0,115200 root=/dev/mmcblk0p4 rw rootwait gpt; bootz 0x41000000 - 0x41800000; fi; echo 'BOOT FAILED'"
CONFIG_BOOTDELAY=0

CONFIG_FASTBOOT_BUF_ADDR=0x40000000
CONFIG_SYS_LOAD_ADDR=0x41000000
CONFIG_SYS_MALLOC_LEN=0xA00000
CONFIG_STACK_SIZE=0x400000
```
